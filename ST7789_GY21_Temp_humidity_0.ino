/* original from https://youtu.be/Igr73QEbazY by Imtiaz Tech
 * v.0 - Nicu FLORICA (niq_ro) changed to GY-21 sensor (HTU21/SHT21 & Si7021)
 */
 
/*ST7789 240x240 IPS (without CS pin) connections (only 6 wires required):

 #01 GND -> GND
 #02 VCC -> VCC (3.3V only!)
 #03 SCL -> D13/SCK
 #04 SDA -> D11/MOSI
 #05 RES -> D9 or any digital
 #06 DC  -> D10 or any digital
 #07 BLK -> NC
*/

#define TFT_DC    10
#define TFT_RST   9 
#define SCR_WD   240
#define SCR_HT   240   // 320 - to allow access to full 240x320 frame buffer
#include <SPI.h>
#include <Adafruit_GFX.h>
#include <Arduino_ST7789_Fast.h>
Arduino_ST7789 lcd = Arduino_ST7789(TFT_DC, TFT_RST);  // https://github.com/cbm80amiga/Arduino_ST7789_Fast

#include <Wire.h>
#include <Adafruit_Sensor.h>
#include <SHT21.h>  // https://github.com/SolderedElectronics/SHT21-Arduino-Library
SHT21 sht;   // i2c

float temperature = 0.;
float humidity = 0.;


const unsigned char BG []PROGMEM = {
0x00, 0x00, 0x00, 0x00, 0x00, 0x00, 0x00, 0x00, 0x00, 0x00, 0x00, 0x00, 0x00, 0x00, 0x00, 0x00,
0x00, 0x00, 0x00, 0x00, 0x00, 0x00, 0x00, 0x00, 0x00, 0x00, 0x00, 0x00, 0x00, 0x00, 0x00, 0x00,
0x00, 0x00, 0x00, 0x00, 0x00, 0x00, 0x00, 0x00, 0x00, 0x00, 0x07, 0xFF, 0xFF, 0x00, 0x00, 0x00,
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0x00, 0x00, 0x00, 0x00, 0x00, 0x00, 0x00, 0x00, 0x00, 0x00, 0x00, 0x00, 0x00, 0x00, 0x00, 0x00
};



const unsigned char Mid []PROGMEM = {
0x00, 0x00, 0x00, 0x00, 0x00, 0x00, 0x00, 0x00, 0x00, 0x00, 0x00, 0x00, 0x00, 0x00, 0x00, 0x00,
0x00, 0x00, 0x00, 0x00, 0x00, 0x00, 0x00, 0x00, 0x00, 0x00, 0x00, 0x00, 0x00, 0x00, 0x00, 0x00,
0x00, 0x00, 0x00, 0x00, 0x00, 0x00, 0x00, 0x00, 0x00, 0x00, 0x00, 0x00, 0x00, 0x00, 0x00, 0x00,
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0x00, 0x00, 0x00, 0x00, 0x00, 0x00, 0x00, 0x00, 0x00, 0x00, 0x00, 0x00, 0x00, 0x00, 0x00, 0x00
};

void setup() 
{
  Serial.begin(115200);
  lcd.init(SCR_WD, SCR_HT);
  lcd.fillScreen();  
}

void loop()
{  
 temperature = sht.getTemperature();
 humidity = sht.getHumidity();

  lcd.setTextColor(0xBFE0);
  lcd.setTextSize(1);
  lcd.setCursor(150,35);
  lcd.print("Temperature");
  lcd.setTextSize(2);
  lcd.setTextColor(0xF7EC,BLACK);
  lcd.setCursor(150,48);
  lcd.print((float)temperature);
  lcd.setTextColor(0xF7EC,BLACK);
  lcd.setTextSize(1);
  lcd.setCursor(211,48);
  lcd.print("o");
  lcd.setTextSize(2);
  lcd.print("C");
  lcd.drawBitmap(0, 0,BG ,240,240,WHITE);

  lcd.setTextColor(0x679F);
  lcd.setTextSize(1); 
  lcd.setCursor(15,77);
  lcd.print("Humidity");
  lcd.setTextSize(2);
  lcd.setTextColor(0x65FF,BLACK);
  lcd.setCursor(15,90);
  lcd.print((float)humidity);
  lcd.print("%");

{
  lcd.setTextSize(1);
lcd.setTextColor(WHITE,BLACK);
String text = " Arduino Temperature & Humidity Meter      "; // sample text

const int width = 40; // width of the marquee display (in characters)

// Loop once through the string

for (int offset = 0; offset < text.length(); offset++)
{

// Construct the string to display for this iteration

String t = "";

for (int i = 0; i < width; i++)

t += text.charAt((offset + i) % text.length());

// Print the string for this iteration
lcd.setCursor(0,230);

lcd.print(t);

// Short delay so the text doesn't move too fast

delay(200);
}

}

if ((float)temperature<=5) {
      lcd.drawBitmap(0, 0,Mid ,240,240,0x009F);
      lcd.setTextColor(0x009F,BLACK);
      lcd.setTextSize(2);
      lcd.setCursor(35,172);
      lcd.print("Temperature is");
      lcd.setCursor(70,195);
      lcd.println("  very cold    ");
}
else if ((float)temperature<=10) {
      lcd.drawBitmap(0, 0,Mid ,240,240,0x07DF);
      lcd.setTextColor(0x07DF,BLACK);
      lcd.setTextSize(2);
      lcd.setCursor(35,172);
      lcd.print("Temperature is");
      lcd.setCursor(70,195);
      lcd.println("  so cold      ");     
}
else if ((float)temperature<=15) {
      lcd.drawBitmap(0, 0,Mid ,240,240,0x07D5); 
      lcd.setTextColor(0x07D5,BLACK);
      lcd.setTextSize(2);
      lcd.setCursor(35,172);
      lcd.print("Temperature is");
      lcd.setCursor(58,195);
      lcd.println(" pretty cold  ");
}
else if ((float)temperature<=20) {
  lcd.drawBitmap(0, 0,Mid ,240,240,0x07C1);    
  lcd.setTextColor(0x07C1,BLACK);
  lcd.setTextSize(2);
  lcd.setCursor(35,172);
  lcd.print("Temperature is");
  lcd.setCursor(58,195);
  lcd.println(" pretty cold  ");
}
else if ((float)temperature<=25) {
  lcd.drawBitmap(0, 0,Mid ,240,240,0xC7C0);
  lcd.setTextColor(0xC7C0,BLACK);
  lcd.setTextSize(2);
  lcd.setCursor(35,172);
  lcd.print("Temperature is");
  lcd.setCursor(60,195);
  lcd.println(" pretty good  ");
}
else if ((float)temperature<=29) {
  lcd.drawBitmap(0, 0,Mid ,240,240,0xFFA0);  
  lcd.setTextColor(0xFFA0,BLACK);
  lcd.setTextSize(2);
  lcd.setCursor(35,172);
  lcd.print("Temperature is");
  lcd.setCursor(60,195);
  lcd.println(" so warm    ");
}
else if ((float)temperature<=34) {
  lcd.drawBitmap(0, 0,Mid ,240,240,0xFBE0);   
  lcd.setTextColor(0xFBE0,BLACK);
  lcd.setTextSize(2);
  lcd.setCursor(35,172);
  lcd.print("Temperature is");
  lcd.setCursor(60,195);
  lcd.println(" so hot    ");
}
} // main loop
